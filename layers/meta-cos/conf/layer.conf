## layers/meta-cos/conf/layer.conf
```bitbake
# We have a conf and classes directory, add to BBPATH
BBPATH .= ":${LAYERDIR}"

# We have recipes-* directories, add to BBFILES
BBFILES += "${LAYERDIR}/recipes/*.bb \
            ${LAYERDIR}/recipes/*.bbappend"

BBFILE_COLLECTIONS += "meta-cos"
BBFILE_PATTERN_meta-cos = "^${LAYERDIR}/"
BBFILE_PRIORITY_meta-cos = "6"

LAYERDEPENDS_meta-cos = "core"
LAYERSERIES_COMPAT_meta-cos = "blacksail wrynose"

IMAGE_INSTALL:append = " libuvc"
IMAGE_INSTALL:append = " tailscale"
IMAGE_INSTALL:append = " rsync"
IMAGE_INSTALL:append = " v4l-utils"
IMAGE_INSTALL:append = " kernel-modules"
IMAGE_INSTALL:append = " l4t-usb-device-mode"
IMAGE_INSTALL:append = " libopencv-videoio"
IMAGE_INSTALL:append = " libjpeg-turbo"
IMAGE_INSTALL:append = " allwpilib"
IMAGE_INSTALL:append = " nginx"
IMAGE_INSTALL:append = " linux-firmware-mediatek"
IMAGE_INSTALL:append = " kernel-module-mt7921e"
IMAGE_INSTALL:append = " connman-client"


IMAGE_INSTALL:append = " htop"
IMAGE_INSTALL:append = " python3-jetson-stats"
IMAGE_INSTALL:append = " valgrind"
IMAGE_INSTALL:append = " perf"
IMAGE_INSTALL:append = " curl"
IMAGE_INSTALL:append = " wget"
IMAGE_INSTALL:append = " ripgrep"
IMAGE_INSTALL:append = " ldd glibc-utils"
IMAGE_INSTALL:append = " coreutils"
IMAGE_INSTALL:append = " lvm2 e2fsprogs-resize2fs"
IMAGE_INSTALL:append = " nsight-systems"

TOOLCHAIN_TARGET_TASK:append = " libuvc-dev libuvc-staticdev"
TOOLCHAIN_TARGET_TASK:append = " opencv-staticdev"
TOOLCHAIN_TARGET_TASK:append = " allwpilib"
TOOLCHAIN_TARGET_TASK:append = " libeigen-dev"
TOOLCHAIN_TARGET_TASK:append = " libjpeg-turbo"

MACHINE_EXTRA_RRECOMMENDS += "linux-firmware-mediatek kernel-module-mt7921e"
PACKAGECONFIG:append:pn-connman = " client"
```

## meta-cos/conf/layer.conf
```bitbake
# We have a conf and classes directory, add to BBPATH
BBPATH .= ":${LAYERDIR}"

# We have recipes-* directories, add to BBFILES
BBFILES += "${LAYERDIR}/recipes/*.bb \
            ${LAYERDIR}/recipes/*.bbappend"

BBFILE_COLLECTIONS += "meta-cos"
BBFILE_PATTERN_meta-cos = "^${LAYERDIR}/"
BBFILE_PRIORITY_meta-cos = "6"

LAYERDEPENDS_meta-cos = "core"
LAYERSERIES_COMPAT_meta-cos = "blacksail wrynose"
```
